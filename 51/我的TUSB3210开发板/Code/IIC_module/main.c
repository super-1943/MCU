#include <reg52.h>
#include "serial.h"
#include "iic.h"

unsigned char code array[]={
0x36,0x21,0x02,0x04,0x00,0x00,0x00,0x00,0x00,0x00,0x02,0x4D,0x00,0x10,0x10,0x02,
0x00,0x3F,0xE4,0xFB,0xF5,0x80,0x7F,0xE8,0x7E,0x03,0x12,0x00,0x2B,0xE4,0xFB,0x12,
0x00,0x25,0xBB,0xFF,0xF9,0x7B,0xFF,0xEB,0xD3,0x94,0x00,0x40,0xEF,0x12,0x00,0x25,
0x1B,0x80,0xF4,0x8B,0x80,0x7F,0x01,0x7E,0x00,0xEF,0x4E,0x60,0x0F,0x7D,0x14,0x7C,
0x64,0xDC,0xFE,0xDD,0xFA,0xEF,0x1F,0x70,0xF0,0x1E,0x80,0xED,0x22,0x78,0x7F,0xE4,
0xF6,0xD8,0xFD,0x75,0x81,0x07,0x02,0x00,0x03,0x00,0x00,0x00};
unsigned char idata buffer[50];

void delay_ms(unsigned int k)
{
	unsigned char i,j;
	for(;k;k--)
	for(i=20;i;i--)
	for(j=100;j;j--);
}
void load_program(void)
{
	unsigned int i,len,count;
	len=sizeof(array);
	rs232_printstr("\r\nThe program has ");
	rs232_printhex(len);
	rs232_printstr("bytes .\r\n");
	for(count=0;count<=len-16;count+=16)
	{
		rs232_printstr("向AT24C08写入以下内容：");
		for(i=0;i<16;i++)
		{
			rs232_printhex(array[i+count]);
		}
		rs232_printstr("\r\n");
		write_content(DEV_ADDR,count,16,array+count);
		delay_ms(100);
	}
	rs232_printstr("向AT24C08写入以下内容：");
	i=count;
	for(;count<len;count++)
	{
		rs232_printhex(array[count]);
	}		
	rs232_printstr("\r\n");
	write_content(DEV_ADDR,i,len%16,array+i);
	delay_ms(100);	
}

void main(void)
{
	unsigned char i;
	unsigned int addr=0;
	rs232_init();
	rs232_printstr("Hello world!\r\n");
	while(1)
	{
		if(addr>0x3ff)
		{
			addr=0;
		}
		if((P3&0x08)==0)//K3
		{
			P0=0xff;
			read_content(DEV_ADDR,addr,16,buffer);
			for(i=0;i<16;i++)
			{
				rs232_printhex(buffer[i]);
			}
			addr+=16;
			rs232_printstr("\r\n");
			delay_ms(100);
		}
		else if((P3&0x04)==0)
		{
			load_program();		
		}
		else
		{
			P0=0x55;
		}
	}
}