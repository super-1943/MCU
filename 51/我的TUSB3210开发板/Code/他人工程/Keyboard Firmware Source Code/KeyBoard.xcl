//                 -LNK8051.XCL-
//
//        XLINK 4.44, or higher, command file to be used with the 8051 
//        C-compiler V5.xx
//        using the -mt, -ms, -mc, -mm or -ml memory model
//        Usage:  xlink  your_file(s)  -f lnk8051l
//
//        First: define CPU  
//
//   Revision control system
//       $Id: lnk8051.xcl 1.14 1998/11/12 07:35:27 matsp Exp $
//


-c8051

// If you have register independent code use: -D_R=0  
// (or 8,16,24) to choose the register bank used at startup 
-D_R=0

//  Setup "bit" segments (always zero if there is no need to reserve
//    bit variable space for some other purpose) 

-Z(BIT)C_ARGB,BITVARS=0

//  Setup "data" segments.  Start address may not be less
//  than start of register bank + 8.  Space must also
//  be left for interrupt functions with the "using" attribute. 

-Z(DATA)B_UDATA,B_IDATA,C_ARGD,D_UDATA,D_IDATA=20

//  Setup "idata" segments (usually loaded after "data") 

-Z(IDATA)C_ARGI,I_UDATA,I_IDATA,CSTACK

//  Setup "xdata" segments to the start address of external RAM.
//  Note that it starts from 1 since a pointer to address zero is regarded
//  as NULL.
//  Note that this declaration does no harm even if you use a memory
//  model that does not utilize external data RAM 

-Z(XDATA)P_UDATA,P_IDATA,C_ARGX,X_UDATA,X_IDATA,ECSTR,RF_XDATA,XSTACK=1

//  Setup all read-only segments (PROM). Usually at zero 

-Z(CODE)INTVEC=0
-Z(CODE)RCODE,D_CDATA,B_CDATA,I_CDATA,P_CDATA,X_CDATA,C_ICALL,C_RECFN,CSTR,CCSTR,CODE,CONST

//  See configuration section concerning printf/sprintf 
-e_small_write=_formatted_write

//  See configuration section concerning scanf/sscanf 
-e_medium_read=_formatted_read

//  Load the 'C' library adapted for the selected memory model 
// cl8051t , cl8051s, cl8051c, cl8051m, cl8051l 

//  Code will now reside on file aout.a03 in INTEL-STANDARD format 

// TUSB2136 XDATA Definition
-Z(XDATA)TUSB2136_SETUPPACKET_SEG=ff00
-Z(XDATA)TUSB2136_EP0_EDB_SEG=ff80
-Z(XDATA)TUSB2136_IEP_EDB_SEG=ff48
-Z(XDATA)TUSB2136_OEP_EDB_SEG=ff08
-Z(XDATA)TUSB2136_IEP0BUFFER_SEG=fef8
-Z(XDATA)TUSB2136_OEP0BUFFER_SEG=fef0
-Z(XDATA)TUSB2136_DESC_SEG=fe80
-Z(XDATA)TUSB2136_OEP1_X_BUFFER_SEG=fed8
-Z(XDATA)TUSB2136_OEP1_Y_BUFFER_SEG=fee0
-Z(XDATA)TUSB2136_IEP1_X_BUFFER_SEG=fee8
-Z(XDATA)TUSB2136_DEBOUNCE_SEG=fd80
// -Z(XDATA)TUSB2136_IEP1_X_BUFFER_SEG=fe00


-Z(XDATA)TUSB2136_EXTERNAL_RAM_SEG=0000

-Z(XDATA)TUSB5152_IO_SEG=c000
