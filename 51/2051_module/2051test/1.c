#include <avr/io.h>
#include <avr/pgmspace.h>

#define databus_w PORTB
#define databus_r PINB
#define xtal_0 (PORTC&=~0x20)
#define xtal_1 (PORTC|=0x20)

#define PROG_1 (PORTC|=0x01)
#define PROG_0 (PORTC&=~0x01)

#define somedata_for_portc
#define WriteCodeData 0x1c
#define ReadCodeData 0x18
#define ChipErase 0x02
#define ReadSignatureByte 0x00

const unsigned char dataforprogram[] PROGMEM={0x08,0x00,0x24,0x00,0x7F,0xC8,0x7E,0xC8,0xDE,0xFE,0xDF,0xFA,0x92,
0x01,0x00,0x2C,0x00,0x22,0xB1,0x10,0x00,0x03,0x00,0x75,0x90,0x01,0x12,0x00
,0x24,0xE5,0x90,0x25,0xE0,0xF5,0x90,0xE5,0x90,0x70,0xF3,0xDA
,0x05,0x00,0x13,0x00,0x75,0x90,0x01,0x80,0xEE,0x74
,0x03,0x00,0x00,0x00,0x02,0x00,0x18,0xE3
,0x0C,0x00,0x18,0x00,0x78,0x7F,0xE4,0xF6,0xD8,0xFD,0x75,0x81,0x07,0x02,0x00,0x03,0x34
,0x00,0x00,0x00,0x01,0xFF};
void initport(void)
{
	asm("NOP");
	DDRB=0xff;
	DDRC=0xff;
	DDRD=0xff;
	PORTB=0x00;
	PORTC=0x00;
	PORTD=0x00;
	asm("NOP");
}

void delay(unsigned int i)
{
	unsigned int a,b;
	while(i--)
	{
		for(a=20;a;a--)
		for(b=100;b;b--)
		asm("NOP");
	}
}

void erasechip(void)
{
	initport();
	PORTC=ChipErase;

	PROG_1;
	delay(1);
	PROG_0;
	delay(10);
	PROG_1;
}

void writecode(unsigned char c)
{
	PORTC=WriteCodeData;
	databus_w=c;

	PROG_1;
	delay(1);
	PROG_0;
	delay(1);
	PROG_1;
	databus_w=0x00;
}

unsigned char readcode(void)
{
	unsigned char a;
	DDRB=0x00;
	PORTB=0x00;
	PORTC=ReadCodeData;

	PROG_1;
	delay(10);
	a=PINB;
	DDRB=0xff;
	return a;
}
unsigned char readmark(void)
{
	unsigned char a;
	DDRB=0x00;
	PORTC=ReadSignatureByte;

	PROG_1;
	delay(10);
	a=PINB;
	DDRB=0xff;
	return a;
}
	

int main(void)
{
	unsigned char *p=dataforprogram;
	initport();
	erasechip();

	while(*p!=0xff)
	{
		writecode(pgm_read_byte(p));
		p++;
		delay(10);
	}
	writecode(pgm_read_byte(p));
	while(1)
	;
}
