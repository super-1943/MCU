
// Resource Table
// Created by IDE, Do not modify this table

.TEXT
.external _RES_Table;
.external _Snd_Table;
.external _RES_0_16K_SA;
.external _RES_0_16K_EA;
.external _RES_1_16K_SA;
.external _RES_1_16K_EA;
.external _RES_2_16K_SA;
.external _RES_2_16K_EA;
.external _RES_3_16K_SA;
.external _RES_3_16K_EA;
.external _RES_4_16K_SA;
.external _RES_4_16K_EA;
.external _RES_5_16K_SA;
.external _RES_5_16K_EA;
.external _RES_6_16K_SA;
.external _RES_6_16K_EA;
.external _RES_7_16K_SA;
.external _RES_7_16K_EA;
.external _RES_8_16K_SA;
.external _RES_8_16K_EA;
.external _RES_9_16K_SA;
.external _RES_9_16K_EA;
.external _RES_10_16K_SA;
.external _RES_10_16K_EA;
.external _RES_11_16K_SA;
.external _RES_11_16K_EA;
.external _RES_12_16K_SA;
.external _RES_12_16K_EA;
.external _RES_DIAN_16K_SA;
.external _RES_DIAN_16K_EA;
.external _RES_DING_16K_SA;
.external _RES_DING_16K_EA;
.external _RES_FEN_16K_SA;
.external _RES_FEN_16K_EA;
.external _RES_LIANG_16K_SA;
.external _RES_LIANG_16K_EA;
.external _RES_LINGCHEN_16K_SA;
.external _RES_LINGCHEN_16K_EA;
.external _RES_MIAO_16K_SA;
.external _RES_MIAO_16K_EA;
.external _RES_NIAN_16K_SA;
.external _RES_NIAN_16K_EA;
.external _RES_RI_16K_SA;
.external _RES_RI_16K_EA;
.external _RES_SHANGWU_16K_SA;
.external _RES_SHANGWU_16K_EA;
.external _RES_WANSHANG_16K_SA;
.external _RES_WANSHANG_16K_EA;
.external _RES_XIANZAISHIKE_16K_SA;
.external _RES_XIANZAISHIKE_16K_EA;
.external _RES_XIAWU_16K_SA;
.external _RES_XIAWU_16K_EA;
.external _RES_YUE_16K_SA;
.external _RES_YUE_16K_EA;
.external _RES_ZHENG_16K_SA;
.external _RES_ZHENG_16K_EA;

// End Table
