//======================================================
// 文件名称：	ISR.asm
// 功能描述：	中断服务程序
// 维护记录：	2006-08-30	v1.0
//======================================================
.INCLUDE SPCE061A.inc
.INCLUDE A2000.inc
.INCLUDE Key.inc

.PUBLIC _FIQ, _IRQ5, _IRQ6 
.EXTERNAL _Clock_ISR

.TEXT
//======================================================
// 函数名称：	_FIQ
// 实现功能：   FIQ中断服务程序，用于语音播放
// 入口参数：	无
// 出口参数：	无
// 破坏寄存器：	无
//======================================================
_FIQ:
	push r1, r5 to [sp]
	r1 = C_FIQ_TMA
	[P_INT_Clear] = r1
	call F_FIQ_Service_SACM_A2000
	pop r1, r5 from [sp]
reti

//======================================================
// 函数名称：	_IRQ5
// 实现功能：   IRQ5_2Hz中断服务程序，用于计时
// 入口参数：	无
// 出口参数：	无
// 破坏寄存器：	无
//======================================================
_IRQ5:
	push r1, r5 to [sp]
	r1 = C_IRQ5_2Hz
	[P_INT_Clear] = r1
	call _Clock_ISR
	pop r1, r5 from [sp]
reti

//======================================================
// 函数名称：	_IRQ6
// 实现功能：   IRQ6_TMB2中断服务程序，用于按键扫描
// 入口参数：	无
// 出口参数：	无
// 破坏寄存器：	无
//======================================================
_IRQ6:
	push r1, r5 to [sp]
	r1 = C_IRQ6_TMB2
	[P_INT_Clear] = r1
	call F_Key_Scan
	pop r1, r5 from [sp]
reti
