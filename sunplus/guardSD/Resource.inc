
// Resource Table
// Created by IDE, Do not modify this table

.TEXT
.external _RES_Table;
.external _RES_1_48K_SA;
.external _RES_1_48K_EA;
.external _RES_12_48K_SA;
.external _RES_12_48K_EA;
.external _RES_15_48K_SA;
.external _RES_15_48K_EA;
.external _RES_2_48K_SA;
.external _RES_2_48K_EA;
.external _RES_3_48K_SA;
.external _RES_3_48K_EA;
.external _RES_7_48K_SA;
.external _RES_7_48K_EA;
.external _RES_6_48K_SA;
.external _RES_6_48K_EA;
.external _RES_5_48K_SA;
.external _RES_5_48K_EA;
.external _RES_18_48K_SA;
.external _RES_18_48K_EA;
.external _RES_17_48K_SA;
.external _RES_17_48K_EA;
.external _RES_16_48K_SA;
.external _RES_16_48K_EA;
.external _RES_4_48K_SA;
.external _RES_4_48K_EA;
.external _RES_4COM_48K_SA;
.external _RES_4COM_48K_EA;
.external _RES_3COM_48K_SA;
.external _RES_3COM_48K_EA;

// End Table
