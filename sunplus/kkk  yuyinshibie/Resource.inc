
// Resource Table
// Created by IDE, Do not modify this table

.TEXT
.external _RES_Table;
.external _RES_MZ_48K_SA;
.external _RES_MZ_48K_EA;
.external _RES_QJ_48K_SA;
.external _RES_QJ_48K_EA;
.external _RES_DC_48K_SA;
.external _RES_DC_48K_EA;
.external _RES_ZG_48K_SA;
.external _RES_ZG_48K_EA;
.external _RES_YG_48K_SA;
.external _RES_YG_48K_EA;
.external _RES_YE_48K_SA;
.external _RES_YE_48K_EA;
.external _RES_YB_48K_SA;
.external _RES_YB_48K_EA;
.external _RES_MY_48K_SA;
.external _RES_MY_48K_EA;
.external _RES_AY_48K_SA;
.external _RES_AY_48K_EA;
.external _RES_JX_48K_SA;
.external _RES_JX_48K_EA;
.external _RES_GJG_48K_SA;
.external _RES_GJG_48K_EA;

// End Table
