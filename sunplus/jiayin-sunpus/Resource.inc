
// Resource Table
// Created by IDE, Do not modify this table

.TEXT
.external _RES_Table;
.external _RES_0_48K_SA;
.external _RES_0_48K_EA;
.external _RES_1_48K_SA;
.external _RES_1_48K_EA;
.external _RES_2_48K_SA;
.external _RES_2_48K_EA;
.external _RES_3_48K_SA;
.external _RES_3_48K_EA;
.external _RES_4_48K_SA;
.external _RES_4_48K_EA;
.external _RES_5_48K_SA;
.external _RES_5_48K_EA;
.external _RES_6_48K_SA;
.external _RES_6_48K_EA;
.external _RES_7_48K_SA;
.external _RES_7_48K_EA;
.external _RES_8_48K_SA;
.external _RES_8_48K_EA;
.external _RES_9_48K_SA;
.external _RES_9_48K_EA;
.external _RES_10_48K_SA;
.external _RES_10_48K_EA;
.external _RES_DIAN_72K_SA;
.external _RES_DIAN_72K_EA;
.external _RES_FEN_72K_SA;
.external _RES_FEN_72K_EA;
.external _RES_WD_48K_SA;
.external _RES_WD_48K_EA;
.external _RES_SSD_72K_SA;
.external _RES_SSD_72K_EA;
.external _RES_GX_48K_SA;
.external _RES_GX_48K_EA;
.external _RES_TR_48K_SA;
.external _RES_TR_48K_EA;
.external _RES_RUH_48K_SA;
.external _RES_RUH_48K_EA;
.external _RES_TQ_48K_SA;
.external _RES_TQ_48K_EA;
.external _RES_XZ_48K_SA;
.external _RES_XZ_48K_EA;
.external _RES_SHOOT1_48K_SA;
.external _RES_SHOOT1_48K_EA;
.external _RES_MUSIC2_72K_SA;
.external _RES_MUSIC2_72K_EA;
.external _RES_MUSIC1_72K_SA;
.external _RES_MUSIC1_72K_EA;

// End Table
