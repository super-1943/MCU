//========================================================
//	文件名称：	A1600.inc
//	功能描述：	A1600的库函数声明（汇编语言）
//	维护记录：	2006-10-16	v1.0, by Qwerty
//========================================================
.IFNDEF __A1600_INC__
.DEFINE __A1600_INC__

//======================================================
// 函数名称：	F_SACM_A1600_Initial
// 实现功能：   A1600初始化
// 入口参数：	无
// 出口参数：	无
// 破坏寄存器：	无
//======================================================
.EXTERNAL F_SACM_A1600_Initial

//======================================================
// 函数名称：	F_SACM_A1600_Play
// 实现功能：   开始A1600语音播放
// 入口参数：	R1:	待播放的语音资源序号
//				R2:	语音输出的DAC通道。
//					1 - DAC1
//					2 - DAC2
//					3 - DAC1+DAC2
//				R3:	是否在播放起始和结束时采取渐入渐出方式
//					0 - 不采取渐入渐出方式
//					1 - 播放起始时采取渐入方式
//					2 - 播放结束时采取渐出方式
//					3 - 播放起始时采取渐入方式，播放结束时采取渐出方式
// 出口参数：	无
// 破坏寄存器：	无
//======================================================
.EXTERNAL F_SACM_A1600_Play

//======================================================
// 函数名称：	F_SACM_A1600_Stop
// 实现功能：   停止A1600放音
// 入口参数：	无
// 出口参数：	无
// 破坏寄存器：	无
//======================================================
.EXTERNAL F_SACM_A1600_Stop

//======================================================
// 函数名称：	F_SACM_A1600_Pause
// 实现功能：   暂停播放，可以通过F_SACM_A1600_Resume函数恢复
// 入口参数：	无
// 出口参数：	无
// 破坏寄存器：	无
//======================================================
.EXTERNAL F_SACM_A1600_Pause

//======================================================
// 函数名称：	F_SACM_A1600_Resume
// 实现功能：   恢复被暂停的播放操作
// 入口参数：	无
// 出口参数：	无
// 破坏寄存器：	无
//======================================================
.EXTERNAL F_SACM_A1600_Resume

//======================================================
// 函数名称：	F_SACM_A1600_Volume
// 实现功能：   设定A1600的播放音量
// 入口参数：	R1:	音量等级，范围0~15，默认为8。
//					该参数为0则无声音输出，为15则以最大音量输出
// 出口参数：	无
// 破坏寄存器：	无
//======================================================
.EXTERNAL F_SACM_A1600_Volume

//======================================================
// 函数名称：	F_SACM_A1600_DAC_FIRType
// 实现功能：   设定DAC输出的滤波方式
// 入口参数：	R1:	输出滤波方式代码，范围0~3。
//					0 - 不进行滤波，解码后以8KHz采样率直接输出
//					1 - 不进行滤波，以二倍采样率(16KHz)插值输出
//					2 - 以二倍采样率(16KHz)进行简易滤波输出
//					3 - 以二倍采样率(16KHz)进行复杂滤波输出
// 出口参数：	无
// 破坏寄存器：	无
//======================================================
.EXTERNAL F_SACM_A1600_DAC_FIRType

//======================================================
// 函数名称：	F_SACM_A1600_ServiceLoop
// 实现功能：   执行A1600解码操作
// 入口参数：	无
// 出口参数：	无
// 破坏寄存器：	无
//======================================================
.EXTERNAL F_SACM_A1600_ServiceLoop

//======================================================
// 函数名称：	F_SACM_A1600_ISR
// 实现功能：   A1600中断服务，应在Timer中断服务程序中执行该函数
// 入口参数：	无
// 出口参数：	无
// 破坏寄存器：	无
//======================================================
.EXTERNAL F_SACM_A1600_ISR

//======================================================
// 函数名称：	F_SACM_A1600_ISR
// 实现功能：   获取当前A1600的播放状态
// 入口参数：	无
// 出口参数：	R1:	A1600播放状态编码
//					bit0 - 1:当前处于放音状态；0:当前不处于放音状态
//					bit1 - 保留
//					bit2 - 1:暂停状态；0:正常状态
//					bit3 - 1:播放时可通过DAC1输出；0:播放时不通过DAC1输出
//					bit4 - 1:播放时可通过DAC2输出；0:播放时不通过DAC2输出
//					bit5 - 1:播放起始时采取渐入方式；0:播放起始时不采取渐入方式
//					bit6 - 1:播放结束时采取渐出方式；0:播放结束时不采取渐出方式
//					bit7~bit14 - 保留
//					bit15 - 放音时，如果当前处于输出缓冲区欠载状态（不能及时进行解码）则该位为1
// 破坏寄存器：	无
//======================================================
.EXTERNAL F_SACM_A1600_Status


//=========================================================================
//	助记符定义
//=========================================================================
.IFNDEF _SACM_API_CONSTANTS_
.DEFINE _SACM_API_CONSTANTS_

.DEFINE	DAC_1			1
.DEFINE	DAC_2			2

.DEFINE RAMP_NONE		0
.DEFINE RAMP_UP			1
.DEFINE RAMP_DN			2
.DEFINE RAMP_UP_DN		3

.DEFINE BITRATE_10K		0				// DVR1600 Only
.DEFINE BITRATE_12K		1				// DVR1600 Only
.DEFINE BITRATE_14K		2				// DVR1600 Only
.DEFINE BITRATE_16K		3				// DVR1600 Only
.DEFINE BITRATE_20K		4				// DVR1600 Only
.DEFINE BITRATE_24K		5				// DVR1600 Only

.DEFINE DAC_FIRTYPE_0	0
.DEFINE DAC_FIRTYPE_1	1
.DEFINE DAC_FIRTYPE_2	2
.DEFINE DAC_FIRTYPE_3	3

.DEFINE ADC_FIRTYPE_0	0				// DVR1600 Only
.DEFINE ADC_FIRTYPE_1	1				// DVR1600 Only
.DEFINE ADC_FIRTYPE_2	2				// DVR1600 Only

.DEFINE STATUS_PLAY		0x0001
.DEFINE STATUS_RECORD	0x0002			// DVR1600 Only
.DEFINE STATUS_PAUSE	0x0004
.DEFINE STATUS_DAC1		0x0008
.DEFINE STATUS_DAC2		0x0010
.DEFINE STATUS_RAMPUP	0x0020
.DEFINE STATUS_RAMPDN	0x0040
.DEFINE STATUS_OVERFLOW	0x8000

.ENDIF
.ENDIF
