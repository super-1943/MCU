//***************说明**********************
/*****************************************
void delay(int ms)
void send_cmd(unsigned char cmd);//向12864发送命令，参数即为命令
void send_data(unsigned char d);//向12864发送数据
void set_pos(unsigned char x,unsigned char y)//X为列地址0-127,Y为页地址0-7;//设置点阵数据地址
void clear(void);//清屏，其实就是全发送0
void init_12864(void);//初始化12864
void set_point(unsigned char x,unsigned char y,unsigned char d);
x:横坐标（0~127）   y:纵坐标(0~63)d:数据(0 or 1)
注意:每一页的每一列都是一个字节，操作这一列的某一行会干扰这一列其他行
void show_picture(const unsignedchar * tab,unsigned char width,unsigned char _8_height)
//tab:点阵数据首地址，即数组名     //width:图片宽度，很重要！0-127
//_8_height:点阵高度，应该为8 的倍数(即页数*8)(8*0-8*7)，否则将多出的部分切除(右移时将多余部分消去)
//如果char型数组容量不够，可换位int,四位的时候用int 
void show_hanzi(unsigned char *hanzi，unsigned char x,unsigned char y,unsigned char limit_num,unsigned char kaishi_num);
//x为列坐标(0-111)，y为页坐标(0-6)，limit_num为每行需要显示的汉子数目(最多8个) //kaishi_num为从数组中的第几个字开始显示 
void show_shuzi(unsigned char x,unsigned char y,unsigned char num)  //x为列坐标(0-119)，y为页坐标(0-6)，num为显示的数字0-9
void show_ascii(unsigned char _8_x,unsigned char _8_y,unsigned char s) //8*_8_x(0-15)为列地址， _8_y(0-6)为页地址
*/
#ifndef _12864_module_h
#define _12864_module_h
//数据与控制接口，针对不同的连接需要做相应的修改
#define DataDir P4DIR
#define CtrlDir P5DIR
#define DataBus P4OUT
#define InBus   P4IN
#define RESET   P5OUT&=~0x02;
#define NoRESET  P5OUT|=0x02;
#define IsData P5OUT|=0x08;
#define IsComd P5OUT&=~0x08;
#define IsRead P5OUT|=0x20;
#define IsWrite P5OUT&=~0x20;
#define E_1 P5OUT|=0x80;
#define E_0 P5OUT&=~0x80;
//********************************************************
//以下为标准常量宏定义，可以直接移植到其他单片机
#define		M_LCD_VDD_SET	M_LCD_SETR_5		//3.3V供电时选此二项
#define		M_LCD_VDD	M_LCD_BIAS_9		//....
//#define	M_LCD_VDD_SET	M_LCD_SETR_4	//5.0V供电时选此二项
//#define	M_LCD_VDD	M_LCD_BIAS_9	//...
                                                //以上只是推荐，反正电阻越大，屏幕越亮

//LCD开关命令
#define		M_LCD_ON		0x00af
#define		M_LCD_OFF		0x00ae
//设置上电控制模式
#define		M_LCD_POWER_BC	0x002c
#define		M_LCD_POWER_VR	0x002a
#define		M_LCD_POWER_VC	0x0029
#define		M_LCD_POWER_ALL	0x002f
//V5电压内部电阻调节设置…… //电阻越大分压越大
#define		M_LCD_SETR_0	0x0020
#define		M_LCD_SETR_1	0x0021
#define		M_LCD_SETR_2	0x0022
#define		M_LCD_SETR_3	0x0023
#define		M_LCD_SETR_4	0x0024
#define		M_LCD_SETR_5	0x0025
#define		M_LCD_SETR_6	0x0026
#define		M_LCD_SETR_7	0x0027
//
#define		M_LCD_ELE_VOL	0x0081		//电量设置模式（显示亮度），先发送一次地址，然后发送一次数据
//偏压设置
#define		M_LCD_BIAS_9	0x00a2		//V5时选此选项设置
#define		M_LCD_BIAS_7	0x00a3	//V3时选此选项设置
//Com 扫描方式设置命令
#define		M_LCD_COM_NOR	0x00c0		//正常方式
#define		M_LCD_COM_REV	0x00c8		//反相
//Segment方向选择
#define		M_LCD_SEG_NOR	0x00a0		//正常
#define		M_LCD_SEG_REV	0x00a1		//反向
//全屏点亮/变暗指令
#define		M_LCD_ALL_LIGNT	0x00a5		//LCD ALL paint ON
#define		M_LCD_ALL_LOW	0x00a4		//Normal Display mode
//正相反相显示控制指令，RAM中数据不变
#define		M_LCD_ALL_NOR	0x00a6		//正相
#define		M_LCD_ALL_REV	0x00a7		//反相
//静态指示器控制指令
#define		M_LCD_STATIC_ON	0x00ad		//ON
#define		M_LCD_STATIC_OFF 0x00ac		//OFF
//设置显示起始行对应RAM行号
#define		M_LCD_BEGIN_LINE 0x0040		//基数，后面可加的尾数可为0~63
//设置当前页基数
#define		M_LCD_COL_PAGE	0x00b0		//基数指令，后可加尾数0~8
//设置当前列基数
#define		M_LCD_COL_LINE_LOW	0x0004		//基数指令，低四位有效
#define		M_LCD_COL_LINE_HIG	0x0010		//基数指令，低四位有效
//**********************************************************************************************
//**********************************************************************************************
/*const unsigned char picture1[]=
{
};
const unsigned char picture2[]=
{
};
const unsigned char picture3[]=
{
};
const unsigned char hanzi1[]={
};*/
const unsigned int ascii[]=       //ASCII范围33-126
{                                 //仍是从左向右，从上向下去，但是一个管两个      
  0x0000,0x0000,0x0000,0x0000,0x0000,0x0000,0x0000,0x0000,
  0x0000,0x00F8,0x0000,0x0000,0x0000,0x0033,0x3000,0x0000,
  0x0010,0x0C06,0x100C,0x0600,0x0000,0x0000,0x0000,0x0000,
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  0x0006,0x0101,0x0202,0x0404,0x0000,0x0000,0x0000,0x0000,
};
const unsigned int digital[]={
  /*--  文字:  0  --*/
/*--  宋体12;  此字体下对应的点阵为：宽x高=8x16   --*/
0x00,0xE0,0x10,0x08,0x08,0x10,0xE0,0x00,0x00,0x0F,0x10,0x20,0x20,0x10,0x0F,0x00,

/*--  文字:  1  --*/
/*--  宋体12;  此字体下对应的点阵为：宽x高=8x16   --*/
0x00,0x10,0x10,0xF8,0x00,0x00,0x00,0x00,0x00,0x20,0x20,0x3F,0x20,0x20,0x00,0x00,

/*--  文字:  2  --*/
/*--  宋体12;  此字体下对应的点阵为：宽x高=8x16   --*/
0x00,0x70,0x08,0x08,0x08,0x88,0x70,0x00,0x00,0x30,0x28,0x24,0x22,0x21,0x30,0x00,

/*--  文字:  3  --*/
/*--  宋体12;  此字体下对应的点阵为：宽x高=8x16   --*/
0x00,0x30,0x08,0x88,0x88,0x48,0x30,0x00,0x00,0x18,0x20,0x20,0x20,0x11,0x0E,0x00,

/*--  文字:  4  --*/
/*--  宋体12;  此字体下对应的点阵为：宽x高=8x16   --*/
0x00,0x00,0xC0,0x20,0x10,0xF8,0x00,0x00,0x00,0x07,0x04,0x24,0x24,0x3F,0x24,0x00,

/*--  文字:  5  --*/
/*--  宋体12;  此字体下对应的点阵为：宽x高=8x16   --*/
0x00,0xF8,0x08,0x88,0x88,0x08,0x08,0x00,0x00,0x19,0x21,0x20,0x20,0x11,0x0E,0x00,

/*--  文字:  6  --*/
/*--  宋体12;  此字体下对应的点阵为：宽x高=8x16   --*/
0x00,0xE0,0x10,0x88,0x88,0x18,0x00,0x00,0x00,0x0F,0x11,0x20,0x20,0x11,0x0E,0x00,

/*--  文字:  7  --*/
/*--  宋体12;  此字体下对应的点阵为：宽x高=8x16   --*/
0x00,0x38,0x08,0x08,0xC8,0x38,0x08,0x00,0x00,0x00,0x00,0x3F,0x00,0x00,0x00,0x00,

/*--  文字:  8  --*/
/*--  宋体12;  此字体下对应的点阵为：宽x高=8x16   --*/
0x00,0x70,0x88,0x08,0x08,0x88,0x70,0x00,0x00,0x1C,0x22,0x21,0x21,0x22,0x1C,0x00,

/*--  文字:  9  --*/
/*--  宋体12;  此字体下对应的点阵为：宽x高=8x16   --*/
0x00,0xE0,0x10,0x08,0x08,0x10,0xE0,0x00,0x00,0x00,0x31,0x22,0x22,0x11,0x0F,0x00,
};
const unsigned char sintable[]=
{    32   , 34 ,   35 ,   37 ,   38 ,   40   , 41   , 43   , 44   , 46 ,   47  ,  48  ,  50,
    51  ,  52  ,  53   , 55 ,   56  ,  57   , 58  ,  59  ,  59   , 60,    61  ,  62,    62,
    63 ,   63  ,  63  ,  64  ,  64  ,  64   , 64   , 64   , 64   , 64  ,  63  ,  63  ,  63,
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    16  ,  17  ,  18  ,  20 ,   21 ,   23   , 24  ,  26  ,  27  ,  29   , 30   , 32
};
//**********************************************************************************************
//**********************************************************************************************
//延时函数
void delay(int ms)
{int i,j;
for(i=0;i<ms;i++)
for(j=0;j<150;j++);
}
//向12864发送命令，参数即为命令
void send_cmd(unsigned char cmd)
{
  IsWrite;
  IsComd;  
  E_1;
  DataBus=cmd;
  E_0;  
}
//向12864发送点阵数据
void send_data(unsigned char d)
{
  IsWrite;
  IsData; 
  E_1;
  DataBus=d;
  E_0; 
}
//设置点阵数据地址
void set_pos(unsigned char x,unsigned char y)//X为列地址,Y为页地址
{
  unsigned char tmp;
  y&=0x0f;
  tmp=0xb0;
  tmp|=y;
  send_cmd(tmp);
  tmp=0x10;
  tmp|=(x>>4);//先取高四位
  send_cmd(tmp);
  x&=0x0f;
  send_cmd(x);
}
//清屏，其实就是全发送0
void clear(void)
{
  unsigned char x,y;
  for(y=0;y<8;y++)
  {
    set_pos(0,y);
    for(x=0;x<128;x++)
    {
      send_data(0x00);//列地址自动往后加
    }
  }
}
//初始化12864
void init_12864(void)
{
  DataDir=0xff;
  DataBus=0x00;
  CtrlDir=0xAA;
  delay(10);
  send_cmd(M_LCD_ON);
  send_cmd(M_LCD_POWER_ALL);  //好像必须用这个,选择其他单个的上电控制都不亮,还没有搞明白是怎么回事
                             //必须设置,否则不亮
  send_cmd(M_LCD_ELE_VOL);  //调整显示屏的亮度
  send_cmd(0x12);//0x01-0x3f
  send_cmd(M_LCD_SETR_5);//V5电压内部电阻调节设置,电阻越大分压越大,0x20-0x27
  send_cmd(M_LCD_COM_NOR);
  clear();
}
/**************************************************
设置对应坐标点
参数：x,y
x:横坐标（0~127）
y:纵坐标(0~63)
d:数据(0 or 1)
************************************************/
void set_point(unsigned char x,unsigned char y,unsigned char d)
{
  unsigned char itsdata=0x01,itsx,itsy;
  itsx=x&0x7f;
  itsy=(y&0x3f)>>3;//相当于取页
  set_pos(127-itsx,itsy);//将原点转到左上角
  itsdata<<=(y&0x07);//即在页里找到对应的行(也就是在某一页的某一列中选择一个点亮)
  if(d)             //但每一页的每一列都是一个字节，操作这一列的某一行会干扰这一列其他行
  {                 //应用时应注意这一点
    send_data(itsdata);
  }
  else
  {
    send_data(0x00);
  }
}
//显示图片
//参数：
//tab:点阵数据首地址，即数组名
//width:图片宽度，很重要！
//_8_height:点阵高度，应该为8 的倍数(即页数*8)，否则将多出的部分切除(右移时将多余部分消去)
void show_picture(const unsigned char * tab,unsigned char width,unsigned char _8_height)
{
  unsigned char x,y;
  _8_height&=0xf8;
  clear();
  for(y=0;y<(_8_height>>3);y++)
  {
    set_pos(0,y);
    for(x=0;x<width;x++)
    {
      send_data(tab[y*width+width-x-1]);
    }
  }
}
//显示汉字
void show_hanzi(const unsigned char * hanzi,unsigned char x,unsigned char y,unsigned char limit_num,unsigned char kaishi_num)
{ unsigned char i,j;                                                          //x为列坐标，y为页坐标     //limit_num为每行需要显示的汉子数目(最多8个)
  for(i=0;i<limit_num;i++)                                 
  {set_pos(112-x,y);//128-16=112                                                               //kaishi_num为从数组中的第几个字开始显示 
   for(j=0;j<16;j++)
    send_data(hanzi[32*(i+kaishi_num)+15-j]);
   set_pos(112-x,y+1);
  for(j=0;j<16;j++)
    send_data(hanzi[32*(i+kaishi_num)+31-j]);
  x+=16;
  }   
}
//显示数字0-9
void show_shuzi(unsigned char x,unsigned char y,unsigned char num)  //x为列坐标(0-119)，y为页坐标(0-6)，num为显示的数字
{ unsigned char j;                                                                                            
    set_pos(120-x,y);//128-8=120                                                         
    for(j=0;j<8;j++)
    send_data(digital[16*num+7-j]);
   set_pos(120-x,y+1);
  for(j=0;j<8;j++)
    send_data(digital[16*num+15-j]);
}
void show_ascii(unsigned char _8_x,unsigned char _8_y,unsigned char s) //8*_8_x(0-15)为列地址， _8_y(0-6)为页地址
{
  unsigned char i;
  _8_x=(8*_8_x);
  set_pos(127-_8_x,_8_y);//(0,0)换到左边
  s-=0x20;
  for(i=0;i<4;i++)
  {
    send_data(ascii[3-i+8*s]);//发送最后数组的低八位
    send_data(ascii[3-i+8*s]>>8);//发送高八位
  }
  set_pos(127-_8_x,_8_y+1);
  for(i=0;i<4;i++)
  {    
    send_data(ascii[7-i+8*s]);
    send_data(ascii[7-i+8*s]>>8);
  }
}
#endif