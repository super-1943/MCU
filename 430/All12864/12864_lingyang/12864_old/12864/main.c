/**********************************************************************
名称：凌阳501液晶驱动程序
作者：赵永科
日期：2009-07-20
*********************************************************************/
#include "msp430x15x.h"

/*
驱动口说明：
该宏在移植时需要改动
P4口为数据总线   DB0~DB7
P5口的1，3，5，7线为控制线 RESET,A0,RW,EP
*/
#define DataBus P4OUT
#define InBus   P4IN
#define RESET  P5OUT&=~0x02;
#define NoRESET P5OUT|=0x02;
#define IsData P5OUT|=0x08;
#define IsComd P5OUT&=~0x08;
#define IsRead P5OUT|=0x20;
#define IsWrite P5OUT&=~0x20;
#define E_1 P5OUT|=0x80;
#define E_0 P5OUT&=~0x80;

//以下为标准常量宏定义，可以直接移植到其他单片机
#define DisplayOn 0xaf
#define DisplayOff 0xae
#define		M_LCD_VDD_SET	M_LCD_SETR_5		//3.3V供电时选此二项
#define		M_LCD_VDD	M_LCD_BIAS_9		//....
//#define	M_LCD_VDD_SET	M_LCD_SETR_4	//5.0V供电时选此二项
//#define	M_LCD_VDD	M_LCD_BIAS_9	//...


//LCD开关命令
#define		M_LCD_ON		0x00af
#define		M_LCD_OFF		0x00ae
//设置上电控制模式
#define		M_LCD_POWER_BC	0x002c
#define		M_LCD_POWER_VR	0x002a
#define		M_LCD_POWER_VC	0x0029
#define		M_LCD_POWER_ALL	0x002f
//V5内部电压调节电阻设置……
#define		M_LCD_SETR_0	0x0020
#define		M_LCD_SETR_1	0x0021
#define		M_LCD_SETR_2	0x0022
#define		M_LCD_SETR_3	0x0023
#define		M_LCD_SETR_4	0x0024
#define		M_LCD_SETR_5	0x0025
#define		M_LCD_SETR_6	0x0026
#define		M_LCD_SETR_7	0x0027
//...end
#define		M_LCD_ELE_VOL	0x0081		//电量设置模式（显示亮度）
//偏压设置
#define		M_LCD_BIAS_9	0x00a2		//V5时选此选项设置
#define		M_LCD_BIAS_7	0x00a1		//V3时选此选项设置
//Com 扫描方式设置命令
#define		M_LCD_COM_NOR	0x00c0		//正常方式
#define		M_LCD_COM_REV	0x00c8		//反相
//Segment方向选择
#define		M_LCD_SEG_NOR	0x00a0		//正常
#define		M_LCD_SEG_REV	0x00a1		//反向
//全屏点亮/变暗指令
#define		M_LCD_ALL_LIGNT	0x00a5		//LCD ALL paint ON
#define		M_LCD_ALL_LOW	0x00a4		//Normal Display mode
//正相反相显示控制指令，RAM中数据不变
#define		M_LCD_ALL_NOR	0x00a6		//正相
#define		M_LCD_ALL_REV	0x00a7		//反相
//静态指示器控制指令
#define		M_LCD_STATIC_ON	0x00ad		//ON
#define		M_LCD_STATIC_OFF 0x00ac		//OFF
//设置显示起始行对应RAM行号
#define		M_LCD_BEGIN_LINE 0x0040		//基数，后面可加的尾数可为0~63
//设置当前页基数
#define		M_LCD_COL_PAGE	0x00b0		//基数指令，后可加尾数0~8
//设置当前列基数
#define		M_LCD_COL_LINE_LOW	0x0004		//基数指令，低四位有效
#define		M_LCD_COL_LINE_HIG	0x0010		//基数指令，低四位有效
//========================================================================//
//API接口函数宏定义
//========================================================================//
/////-----       屏幕尺寸	    -----/////
#define SCR_MAX_COL		128	
#define SCR_MAX_ROW		64						
//#define TEXT_MAX_COL	20
//#define TEXT_MAX_ROW	4

/////-----       电源模式	    -----/////
#define PWR_ON			0x0001					
#define	PWR_OFF			0x0000
#define PWR_SLEEP		0x0002
#define PWR_STDBY		0x0003

/////-----       图形显示模式	    -----/////
#define PAINT_COVER		0
#define PAINT_SET		1
#define PAINT_CLR		2
#define PAINT_REV		3
#define PAINT_RECO		4

#define PAINT_HOLLOW	0
#define PAINT_SOLID	1

//以下为数组内容
unsigned int i,j,stat;
const unsigned char table1[]=
{
/*--  调入了一幅图像：C:\Documents and Settings\Student\My Documents\我也爱电脑.bmp  --*/
/*--  宽度x高度=101x46  --*/
/*--  高度不是8的倍数，现调整为：宽度x高度=101x48  --*/
0x00,0x00,0x00,0x00,0x00,0x00,0x00,0x00,0x00,0x00,0x00,0x00,0x00,0x00,0x00,0x00,
0x00,0x00,0x00,0x00,0x00,0xFF,0x01,0x01,0xF9,0xFA,0xFA,0xFA,0xF2,0xF4,0xF4,0xF4,
0xE4,0xE8,0xE8,0xE8,0xC8,0xD0,0xD0,0xD0,0x90,0xA0,0xA1,0xA1,0x21,0x41,0x42,0x42,
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0x00,0x06,0x01,0x04,0x07,0x00,0x07,0x04,0x04,0x05,0x04,0x07,0x00,0x00,
};
const unsigned char table2[]=
{
  /*--  调入了一幅图像：C:\Documents and Settings\Student\My Documents\我把妹妹弄丢了.bmp  --*/
/*--  宽度x高度=101x46  --*/
/*--  高度不是8的倍数，现调整为：宽度x高度=101x48  --*/
0x00,0x00,0x00,0x00,0xB0,0xD8,0xF8,0xFC,0xFE,0xFE,0xFF,0xFF,0xFF,0xFF,0xFF,0xFF,
0xFF,0xFF,0xFF,0xFF,0xFF,0xFF,0xFF,0xFF,0xFF,0xFF,0x3F,0x07,0xFF,0x3F,0x0F,0x1F,
0x7F,0xFF,0xFF,0xFF,0x7F,0xFF,0xFF,0xFF,0xFF,0xFF,0xFF,0xFF,0xFF,0xFF,0xDB,0x32,
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0x00,0x00,0x00,0x00,0x00,0x00,0x00,0x00,0x00,0x00,0x00,0x00,0x00,0x00,
};
const unsigned char table3[]=
{
  /*--  调入了一幅图像：C:\Documents and Settings\Student\My Documents\爽.bmp  --*/
/*--  宽度x高度=101x46  --*/
/*--  高度不是8的倍数，现调整为：宽度x高度=101x48  --*/
0x00,0x00,0x00,0x00,0x00,0x00,0x00,0x00,0x60,0x60,0xE0,0xE0,0x70,0x7C,0xFC,0xFC,
0xFC,0xF8,0xF8,0xF8,0xF8,0xF8,0xB8,0x38,0x00,0x00,0x00,0x00,0x10,0xF8,0xFC,0xF8,
0x30,0x00,0x00,0x00,0x00,0x00,0x00,0x00,0x00,0x00,0x00,0x00,0x00,0x00,0x00,0x00,
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0x00,0x00,0x00,0x00,0x00,0x00,0x00,0x00,0x00,0x00,0x00,0x00,0x00,0x00,
};

//函数声明
void init_lcd(void);
void send_cmd(unsigned char cmd);
void send_data(unsigned char d);
void delay(unsigned int t);
unsigned char read_stat(void);
unsigned char read_data(void);
void set_pos(unsigned char x,unsigned char y);
void clear(void);
void show_picture(const unsigned char * tab,unsigned char width,unsigned char _8_height);



//主函数
int main( void )
{
  // Stop watchdog timer to prevent time out reset
  WDTCTL = WDTPW + WDTHOLD;
  RESET;
  delay(10000);
  NoRESET;
  init_lcd();
  clear();
  delay(60000);
//  clear();
  while(1)
  {
    show_picture(table1,101,48);
    for(i=0x40;i<0x80;i++)
    {
      delay(10000);
      send_cmd(i);
    }
    delay(60000);
    show_picture(table2,101,48);
    for(i=0x40;i<0x80;i++)
    {
      delay(10000);
      send_cmd(i);
    }
    delay(60000);
    show_picture(table3,101,48);
    for(i=0x40;i<0x80;i++)
    {
      delay(10000);
      send_cmd(i);
    }
    delay(60000);  
  }

}


//向12864发送命令，参数即为命令
void send_cmd(unsigned char cmd)
{
  E_0;
  _NOP();
  IsWrite;
  IsComd;
  _NOP();  
  E_1;
  delay(1);
  DataBus=cmd;
  delay(1);
  E_0;
  
}



//向12864发送点阵数据
void send_data(unsigned char d)
{
  E_0;
  _NOP();
  IsWrite;
  IsData;
  _NOP();  
  E_1;
  _NOP();
  DataBus=d;
  _NOP();
  _NOP();
  E_0;
}

//初始化12864
void init_lcd(void)
{
  P4DIR=0xff;
  P4OUT=0x0f;
  P2DIR=0x10;
  P5DIR=0xaa;
  delay(3000);
  send_cmd(M_LCD_ON);
  stat=read_stat();
  send_cmd(M_LCD_POWER_ALL);  
  stat=read_stat();
  send_cmd(M_LCD_ELE_VOL);  
  stat=read_stat();
  send_cmd(0x12);
  stat=read_stat();
  send_cmd(M_LCD_VDD_SET);
  stat=read_stat();
  send_cmd(M_LCD_COM_NOR);
  stat=read_stat();  
  clear();
/*  unsigned char x,y;
  for(y=0;y<6;y++)
  {
    set_pos(0,y);
    for(x=0;x<101;x++)
    {
      send_data(table[y*101+101-1-x]);
      stat=read_stat();
    }
  }
  */
}
//延时
void delay(unsigned int t)
{
  while(t--);
}
//读状态字
unsigned char read_stat(void)
{
  unsigned char t;
  P4DIR=0x00;
  P4OUT=0xff;
  E_0;
  IsComd;
  IsRead;
  _NOP();
  E_1;
  _NOP();
  E_0;
  t=P4IN;
  P4DIR=0xff;
  return t;
}

//读数据
unsigned char read_data(void)
{
  unsigned char t;
  P4DIR=0x00;
  P4OUT=0xff;
  E_0;
  IsData;
  IsRead;
  _NOP();
  E_1;
  _NOP();
  E_0;
  t=P4IN;
  P4DIR=0xff;
  return t;
}
//设置点阵数据地址
void set_pos(unsigned char x,unsigned char y)
{
  unsigned char tmp;
  y&=0x0f;
  tmp=0xb0;
  tmp|=y;
  send_cmd(tmp);
  stat=read_stat();
  tmp=0x10;
  tmp|=(x>>4);
  send_cmd(tmp);
  stat=read_stat();
  x&=0x0f;
  send_cmd(x);
  stat=read_stat();
}

//清屏
void clear(void)
{
  unsigned char x,y;
  for(y=0;y<8;y++)
  {
    set_pos(0,y);
    stat=read_stat();
    for(x=0;x<128;x++)
    {
      send_data(0x00);
      stat=read_stat();
    }
  }
}

//显示图片
//参数：
//tab:点阵数据首地址，即数组名
//width:图片宽度，很重要！
//_8_height:点阵高度，应该为8 的倍数，否则将多出的部分切除
void show_picture(const unsigned char * tab,unsigned char width,unsigned char _8_height)
{
  unsigned char x,y;
  _8_height&=0xf8;
  clear();
  for(y=0;y<(_8_height>>3);y++)
  {
    set_pos(0,y);
    for(x=0;x<width;x++)
    {
      send_data(tab[y*width+width-x]);
      stat=read_stat();
    }
  }
}